## boards/shields/zorne/Kconfig.defconfig
```kconfig
if SHIELD_ZORNE_DONGLE

config ZMK_KEYBOARD_NAME
	default "Zorne"

config ZMK_SPLIT_BLE_ROLE_CENTRAL
	default y
config CONFIG_ZMK_SPLIT_BLE_CENTRAL_PERIPHERALS
  int "Peripheral count"
  default 2
config ZMK_USB
	default y
endif

if SHIELD_ZORNE_LEFT || SHIELD_ZORNE_RIGHT || SHIELD_ZORNE_DONGLE
config ZMK_SPLIT
	default y
config ZMK_BLE
  default y
endif
```
